/*
 ******************************************************************************
 File:     main.c
 Info:     Generated by Atollic TrueSTUDIO(R) 6.0.0   2016-09-27

 The MIT License (MIT)
 Copyright (c) 2009-2016 Atollic AB

 Permission is hereby granted, free of charge, to any person obtaining a copy
 of this software and associated documentation files (the "Software"), to deal
 in the Software without restriction, including without limitation the rights
 to use, copy, modify, merge, publish, distribute, sublicense, and/or sell
 copies of the Software, and to permit persons to whom the Software is
 furnished to do so, subject to the following conditions:

 The above copyright notice and this permission notice shall be included in all
 copies or substantial portions of the Software.

 THE SOFTWARE IS PROVIDED "AS IS", WITHOUT WARRANTY OF ANY KIND, EXPRESS OR
 IMPLIED, INCLUDING BUT NOT LIMITED TO THE WARRANTIES OF MERCHANTABILITY,
 FITNESS FOR A PARTICULAR PURPOSE AND NONINFRINGEMENT. IN NO EVENT SHALL THE
 AUTHORS OR COPYRIGHT HOLDERS BE LIABLE FOR ANY CLAIM, DAMAGES OR OTHER
 LIABILITY, WHETHER IN AN ACTION OF CONTRACT, TORT OR OTHERWISE, ARISING FROM,
 OUT OF OR IN CONNECTION WITH THE SOFTWARE OR THE USE OR OTHER DEALINGS IN THE
 SOFTWARE.
 ******************************************************************************
 */

/* Includes */
#include <stddef.h>
#include "stm32l1xx.h"

/* Private typedef */
/* Private define  */
/* Private macro */
/* Private variables */
/* Private function prototypes */
/* Private functions */

/**
 **===========================================================================
 **
 **  Abstract: main program
 **
 **===========================================================================
 */

void initGPIOA(char pin) {
	RCC_AHBPeriphClockCmd(RCC_AHBPeriph_GPIOA, ENABLE);

	//setting GPIO output, pushpull, pullup, very high speed
	GPIOA->MODER |= (uint32_t) (0b01 << (2 * pin));
	GPIOA->PUPDR |= (uint32_t) (0b01 << (2 * pin));

	GPIOA->OTYPER &= (uint32_t) (~(1 << pin));
	GPIOA->OSPEEDR |= (uint32_t) (0b11 << (2 * pin));
}

void initGPIOC(char pin) {
	RCC_AHBPeriphClockCmd(RCC_AHBPeriph_GPIOC, ENABLE);

	GPIOA->MODER |= (uint32_t) (0b00 << (2 * pin));
	GPIOA->PUPDR |= (uint32_t) (0b00 << (2 * pin));

	GPIOA->OTYPER &= (uint32_t) (~(1 << pin));
	GPIOA->OSPEEDR |= (uint32_t) (0b11 << (2 * pin));
}

void setLedBSRR(char status) {
	if (status == 1)
		GPIOA->BSRRL |= (uint16_t) (1 << 5);
	else
		GPIOA->BSRRH |= (uint16_t) (1 << 5);
}

void setLedODR(char status) {
	if (status == 1)
		GPIOA->ODR |= (uint32_t) (1 << 5);
	else
		GPIOA->ODR &= (uint32_t) (~(1 << 5));
}

void setLedToggle() {
	GPIOA->ODR ^= (uint32_t) (1 << 5);
}

char getButton() {
	if ((GPIOC->IDR & (1 << 13)) && (1 << 13)) {
		delay(10000);
		return (GPIOC->IDR & (1 << 13)) && (1 << 13);
	}
}

char getButtonByLibrary(){
	if(GPIO_ReadInputDataBit(GPIOC,GPIO_Pin_13)){
		delay(10000);
		return GPIO_ReadInputDataBit(GPIOC,GPIO_Pin_13);
	}
}

void delay(long time) {
	for (long i = 0; i < time; i++)
		;
}

int main(void) {

	//nastavenie vystupu GPIO 5
	GPIO_InitTypeDef GPIO_InitStructure;
	/* Enable the GPIO Clock */
	RCC_AHBPeriphClockCmd(RCC_AHBPeriph_GPIOA, ENABLE);
	/* Configure the GPIO pin */
	GPIO_InitStructure.GPIO_Pin = GPIO_Pin_5;
	GPIO_InitStructure.GPIO_Mode = GPIO_Mode_OUT;
	GPIO_InitStructure.GPIO_OType = GPIO_OType_PP;
	GPIO_InitStructure.GPIO_PuPd = GPIO_PuPd_UP;
	GPIO_InitStructure.GPIO_Speed = GPIO_Speed_40MHz;
	GPIO_Init(GPIOA, &GPIO_InitStructure);

	//nastavenie vstupu GPIO 13
	/* Enable the GPIO Clock */
	RCC_AHBPeriphClockCmd(RCC_AHBPeriph_GPIOC, ENABLE);
	/* Configure Button pin as input */
	GPIO_InitStructure.GPIO_Mode = GPIO_Mode_IN;
	GPIO_InitStructure.GPIO_PuPd = GPIO_PuPd_NOPULL;
	GPIO_InitStructure.GPIO_Pin = GPIO_Pin_13;
	GPIO_Init(GPIOC, &GPIO_InitStructure);

	GPIO_ReadInputDataBit(GPIOC,GPIO_Pin_13);
	//initGPIOA(5);
	//initGPIOC(13);
	while (1) {
		setLedToggle();
		delay(40000);
		/*
		if(getButtonByLibrary()){
			GPIO_ToggleBits(GPIOA,GPIO_Pin_5);
			while(getButtonByLibrary());
		}
		*/
		//setLedODR(getButton());
		/*if(getButton()){
		 setLedToggle();
		 while(getButton());
		 }*/
	}
	return 0;
}

#ifdef  USE_FULL_ASSERT

/**
 * @brief  Reports the name of the source file and the source line number
 *   where the assert_param error has occurred.
 * @param  file: pointer to the source file name
 * @param  line: assert_param error line source number
 * @retval None
 */
void assert_failed(uint8_t* file, uint32_t line)
{
	/* User can add his own implementation to report the file name and line number,
	 ex: printf("Wrong parameters value: file %s on line %d\r\n", file, line) */

	/* Infinite loop */
	while (1)
	{
	}
}
#endif

/*
 * Minimal __assert_func used by the assert() macro
 * */
void __assert_func(const char *file, int line, const char *func,
		const char *failedexpr) {
	while (1) {
	}
}

/*
 * Minimal __assert() uses __assert__func()
 * */
void __assert(const char *file, int line, const char *failedexpr) {
	__assert_func(file, line, NULL, failedexpr);
}
